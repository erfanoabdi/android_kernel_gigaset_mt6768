## drivers/input/touchscreen/mediatek/Kconfig
```kconfig
#
# Touchscreen driver configuration
#
menuconfig INPUT_TOUCHSCREEN
	bool "Touchscreens"
	help
	  Say Y here, and a list of supported touchscreens will be displayed.
	  This option doesn't affect the kernel.

	  If unsure, say Y.

if INPUT_TOUCHSCREEN

config TOUCHSCREEN_MTK
	bool "MediaTek Touch Panel Driver"
	help
	  Say Y here if you have MediaTek touch panel.

	  If unsure, say N.

	  To compile this dirver as a module, choose M here: the
	  module will be called.

config TOUCHSCREEN_PHYSICAL_ROTATION_WITH_LCM
	bool "MediaTek Touch Panel Rotation With LCM"
	default y
	help
	  Say N here if touch panel is not physical rotated as LCM does.
	  Physically rotated means that this driver will map
	  the reported coordination to diagonal position.

	  If unsure, say Y.
config TOUCHSCREEN_MTK_SOLOMON
	bool "SOLOMON for Mediatek package"
	default n
	help
	  Say Y here if you have SOLOMON touch panel.

	  If unsure, say N.

	  To compile this dirver as a module, choose M here: the
	  module will be called.


config TOUCHSCREEN_MTK_FOCALTECH_TS
	bool "FOCALTECH_TS for Mediatek package"
	default n
	help
	  Say Y here if you have focaltech_touch touch panel.

	  If unsure, say N.

	  To compile this dirver as a module, choose M here: the
	  module will be called.

source "drivers/input/touchscreen/mediatek/focaltech_touch/Kconfig"

config TOUCHSCREEN_MTK_GT1151
	bool "GT1151 for Mediatek package"
	default n
	help
	  Say Y here if you have GT1151 touch panel.

	  If unsure, say N.

	  To compile this dirver as a module, choose M here: the
	  module will be called.

source "drivers/input/touchscreen/mediatek/GT1151/Kconfig"

config TOUCHSCREEN_MTK_GSLX680
	bool "gslX680 for Mediatek package"
	help
	  Say Y here if you have gslX680 touch panel.

	  If unsure, say N.

	  you can config it if you want to use MTK9XX_LM for
	  touch panel.

config TOUCHSCREEN_MTK_NT36xxx
	bool "NT36xxx for Mediatek package"
	default n
	help
	  Say Y here if you have NT36xxx touch panel.

	  If unsure, say N.

	  To compile this dirver as a module, choose M here: the
	  module will be called.

source "drivers/input/touchscreen/mediatek/NT36xxx/Kconfig"

config TOUCHSCREEN_MTK_GT9XX_LM
	bool "GT9XX_LM for Mediatek package"
	help
	  Say Y here if you have GT9XX_LM touch panel.

	  If unsure, say N.

	  you can config it if you want to use MTK9XX_LM for
	  touch panel.

source "drivers/input/touchscreen/mediatek/GT9XX_LM/Kconfig"

config TOUCHSCREEN_FT5X26
	bool "FT5X26 for Mediatek package"
	help
	  Say Y here if you have FT5X26 touch panel.

	  If unsure, say N.

	  To compile this dirver as a module, choose M here: the
	  module will be called.

config TOUCHSCREEN_FT5X26_WUXGA
	bool "FT5X26 WUXGA for Mediatek package"
	help
	  Say Y here if you have FT5X26 touch panel.

	  If unsure, say N.

	  To compile this dirver as a module, choose M here: the
	  module will be called.

source "drivers/input/touchscreen/mediatek/FT5X26/Kconfig"

config TOUCHSCREEN_MTK_GT5688
	bool "GT1151 for Mediatek package"
	help
	  Say Y here if you have GT5688 touch panel.

	  If unsure, say N.

	  To compile this dirver as a module, choose M here: the
	  module will be called.

source "drivers/input/touchscreen/mediatek/GT5688/Kconfig"
source "drivers/input/touchscreen/mediatek/hxchipset/Kconfig"

config TOUCHSCREEN_HIMAX_CHIPSET_8789P1_8185P3
	bool "hxchipset for Mediatek 8789p1 and 8185p3 package"
	default n
	help
	  Say Y here if you have hxchipset touch panel.

	  If unsure, say N.

	  To compile this dirver as a module, choose M here: the
	  module will be called.

source "drivers/input/touchscreen/mediatek/hxchipset_8789p1_8185p3/Kconfig"

config TOUCHSCREEN_MTK_GT911
	bool "GT911 for Mediatek package"
	help
	  Say Y here if you have GT911 touch panel.

	  If unsure, say N.
	  this is a GT911 touch driver config, you can use it
	  if you want.

source "drivers/input/touchscreen/mediatek/GT911/Kconfig"

config TOUCHSCREEN_MTK_FOCALTECH_FHD
	bool "Focaltech FHD Touchscreen"
	depends on I2C
	help
	  Say Y here if you have Focaltech touch panel.
	  If unsure, say N.

config TOUCHSCREEN_MTK_GT9157
	bool "GT9157 for Mediatek package"
	help
	  Say Y here if you have GT9157 touch panel.

	  If unsure, say N.

	  To compile this dirver as a module, choose M here: the
	  module will be called

source "drivers/input/touchscreen/mediatek/GT9157/Kconfig"
#prize-add-lishuwen-20191226-start
config TOUCHSCREEN_MTK_GT9XX_PRIZE
	bool "GT9XX for Mediatek package"
	default n
	help
	  Say Y here if you have GT9XX touch panel.
	  If unsure, say N.
	  To compile this dirver as a module, choose M here: the
	  module will be called.	  
source "drivers/input/touchscreen/mediatek/GT9XX_prize/Kconfig"
#prize-add-lishuwen-20191226-end

#prize by xuejian add fts 20220514 start
config TOUCHSCREEN_FOCALTECH_TOUCH_V33
	bool "FOCALTECH_TOUCH_V33 touchscreen"
	default n
	help
	  Say Y here if you have a FOCALTECH_TOUCH_V33 touchscreen connected
	  to your system.

	  If unsure, say N.
#prize by xuejian add fts 20220514 end
#prize by pengzhipeng add ILITEK 20220701 end
config TOUCHSCREEN_MTK_ILITEK_V3
	bool "ILITEK chipset i2c touchscreen"
	help
	  This enables support for ILITEK CHIPSET over I2C based touchscreens.
	  when turn this option on, TOUCHSCREEN_ILITEK_I2C touch driver
	  will open.
	  If unsure,say N.
#prize by pengzhipeng add ILITEK 20220701 end
config TOUCHSCREEN_HIMAX_CHIPSET
	bool "Himax touchpanel CHIPSET"
	depends on SPI
	help
	Say Y here if you have a Himax CHIPSET touchscreen.
	HIMAX controllers are multi touch controllers which can
	report 10 touches at a time.

	If unsure, say N.
source "drivers/input/touchscreen/mediatek/hxchipset_hx83102p/Kconfig"

config TOUCHSCREEN_GOODIX_BRL
	bool "Goodix berlin touchscreen"
	help
	  Say Y here if you have a Goodix berlin series touch controller
	  to your system.

	  If build module, say M.
	  If unsure, say N.
source "drivers/input/touchscreen/mediatek/goodix_berlin_driver/Kconfig"

# prize diliwu add tp 20191222 start
config TOUCHSCREEN_CHIPONE
        tristate "Chipone TDDI touchscreen for Mediatek package"
        depends on I2C
        default n
        help
          Say y here if you have chipone TDDI touch panel.
          If unsure, say N.
          To compile this driver as a module, choose M here: the
          module will be called chipone-tddi.
# prize diliwu add tp 20191222 end
endif

# prize add start
config TOUCHSCREEN_ILITEK9882_SPI 
        tristate " ILITEK9882 touchscreen for Mediatek package"
        depends on I2C || SPI
        default n
        help
          Say y here if you have ILITEK9882 touch panel.
          If unsure, say N.
          To compile this driver as a module, choose M here: the
          module will be called ILITEK9882.
# prize add end 
```

## drivers/misc/mediatek/accdet/Kconfig
```kconfig
config MTK_ACCDET
	bool "MediaTek ACCDET driver"
	help
	  ACCDET driver is for headset detect and support for MediaTek SOC
	  If you want to use MediaTek ACCDET driver,
	  say Y.
	  If unsure, say N.

config ACCDET_EINT_IRQ
	bool "MediaTek ACCDET PMIC EINT"
	help
	  ACCDET Internal EINT(PMIC) support for MediaTek SOC
	  If you want to use MediaTek ACCDET EINT from PMIC,
	  say Y.
	  If unsure, say N.

config ACCDET_SUPPORT_EINT0
	bool "MediaTek ACCDET PMIC EINT0"
	help
	  ACCDET use Internal EINT0(PMIC) support for MediaTek SOC
	  If you just want to use MediaTek PMIC ACCDET EINT0,
	  say Y.
	  If unsure, say N.
#PRIZE
#prize added by huarui, headset support, 20190111-start
config PRIZE_TYPEC_ACCDET
	bool "PRIZE_TYPEC_ACCDET"
	depends on TCPC_CLASS
	default n
	---help---
	  If unsure, say N.
config PRIZE_SWITCH_SGM3798_SUPPORT
	bool "MediaTek ACCDET sgm3798"
	#depends on USB_C_SWITCH
	default n
	---help---
	  SGM3798 support for typec headset
	  
config PRIZE_NO_PRIZE_TYPEC
	bool "PRIZE_TYPEC"
	depends on TCPC_CLASS
	default n
	---help---
	  If unsure, say N.
```

## drivers/misc/mediatek/base_charger/Kconfig
```kconfig
config PRIZE_BASE_CHARGER
	bool "PRIZE BASE CHARGER"
	default n
	help
		prize base charger sysfs driver
```

## drivers/misc/mediatek/hardware_info/Kconfig
```kconfig
config PRIZE_HARDWARE_INFO
  bool "HARDWARE_INFO"
  default n
  help
    Dummy Lens Driver
    This config is used to enable the corresponding
    lens driver for the camera sensor module
    Set as y if the driver is used in this project

config PRIZE_HARDWARE_INFO_BAT
  bool "PRIZE_HARDWARE_INFO_BAT"
  depends on PRIZE_HARDWARE_INFO
  default n
  help
    This config is used to enable battery info
	displayed in hardware info.
	
config PRIZE_CTS
  bool "HARDWARE_EFUSE_INFO"
  default n
  help
    Dummy EFUSE flown status info
    
# Prize HanJiuping added 20210818 for LAVA customized hardware info requirement start
config PRIZE_HARDWARE_INFO_LAVA_CUST
  bool "PRIZE_HARDWARE_INFO_LAVA_CUST"
  depends on PRIZE_HARDWARE_INFO
  default n
  help
    This is customized hardware info requirement of LAVA from India
    Should only say Y for LAVA project
# Prize HanJiuping added 20210818 for LAVA customized hardware info requirement end
	
config DISPLAY_MMC_LIFE
  bool "DISPLAY_MMC_LIFE"
  default n
  help
    DISPLAY_MMC_LIFE
	
config PRIZE_TYPEC_POSITIVE_NEGATIVE
  bool "HARDWARE_INFO"
  default n
  help
    Dummy EFUSE flown status info	
	
config PRIZE_TYPEC_PN_OTG_ONLY
  bool "HARDWARE_INFO"
  default n
  help
    Dummy EFUSE flown status info	
```

## drivers/misc/prize/dual_camera/Kconfig
```kconfig
config PRIZE_DUAL_CAMERA
	bool "Support prize_dual_camera function"
	default n
	help
		 Select Y to enable prize_dual_camera function
		 
config PRIZE_DUAL_CAMERA_REAR
	bool "Support prize_dual_camera rear function"
	default n
	select PRIZE_DUAL_CAMERA
	help
		Select Y to enable prize_dual_camera function
		 
config PRIZE_DUAL_CAMERA_FRONT
	bool "Support prize_dual_camera front function"
	default n
	select PRIZE_DUAL_CAMERA
	help
		Select Y to enable prize_dual_camera function
```

## drivers/misc/prize/wl2868c/Kconfig
```kconfig
config PRIZE_CAMERA_LDO_WL2868C
	bool "Support camera pmic wl2868c function"
	default n
	help
		 Select Y to enable camera pmic wl2868c function
```
