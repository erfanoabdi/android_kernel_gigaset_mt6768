/*mono dtsi config*/
//modify by yantaotao for single PA start
&i2c6 {
/* AWINIC AW87XXX Smart K PA */
	aw87xxx_pa@58 {
		compatible = "awinic,aw87xxx_pa";
		reg = <0x58>;
		//reset-gpio = <&pio 1 0>;
		dev_index = < 0 >;
		status = "okay";
	};
/* AWINIC AW87XXX Smart K PA End */
};
//modify by yantaotao for single PA end

